## drivers/sensor/Kconfig
```kconfig
# SPDX-License-Identifier: Apache-2.0

if SENSOR
rsource "mydummysensor/Kconfig"
endif # SENSOR
```

## drivers/sensor/mydummysensor/Kconfig
```kconfig
# SPDX-License-Identifier: Apache-2.0

config MYDUMMYSENSOR
	bool "My Dummy sensor"
	default y
	select GPIO
	help
	  Enable my dummy sensor
```
